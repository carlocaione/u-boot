## arch/arm/mach-meson/Kconfig
```kconfig
if ARCH_MESON

config MESON_GXBB
	bool "Meson GXBaby"
	select ARM64
	select DM
	select DM_SERIAL
	help
	  The Amlogic Meson GXBaby (S905) is a ARM-base SoC with a
	  quad-core Cortex-A53.

if MESON_GXBB

config TARGET_ODROID_C2
	bool "ODROID-C2"
	help
	  ODROID-C2 is a Meson GXBaby-based board.

endif

config SYS_SOC
	default "meson"

config SYS_MALLOC_F_LEN
	default 0x1000

source "board/hardkernel/odroid-c2/Kconfig"

endif
```

## configs/odroid-c2_defconfig
```kconfig
CONFIG_ARM=y
CONFIG_ARCH_MESON=y
CONFIG_MESON_GXBB=y
CONFIG_TARGET_ODROID_C2=y
CONFIG_SYS_TEXT_BASE=0x8000000
CONFIG_DEFAULT_DEVICE_TREE="meson-gxbb-odroid-c2"
CONFIG_OF_CONTROL=y
# CONFIG_CMD_BDI is not set
# CONFIG_CMD_IMI is not set
# CONFIG_CMD_IMLS is not set
# CONFIG_CMD_LOADS is not set
# CONFIG_CMD_FPGA is not set
# CONFIG_CMD_SOURCE is not set
# CONFIG_CMD_SETEXPR is not set
```
